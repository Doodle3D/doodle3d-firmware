## Config.in
```kconfig
# Doodle3D Wifibox configuration
#menu "Configuration"
#	depends on PACKAGE_wifibox

	config WIFIBOX_DEVEL_PACKAGE
		depends on PACKAGE_wifibox
		bool "Enable development aids"
		default n
		help
			Enable development features (currently two shell aliases for convenience,
			see /root/.profile and a test interface for the REST API).

	config WIFIBOX_AP_SSID
		depends on PACKAGE_wifibox
		string "AP mode SSID"
		default "d3d-ap-%%MAC_TAIL%%"
		help
			The SSID the device will use when switching into access point mode.
			Note: the Lua scripts do not actually use this yet.
	
	config WIFIBOX_INIT_PRIORITY
		depends on PACKAGE_wifibox
		int "Init-script priority"
		default "18"
		help
			The priority given to the auto-wifi init-script.
	
	config WIFIBOX_WIRELESS_DEVICE
		depends on PACKAGE_wifibox
		string "Physical wireless device name"
		default "radio0"
		help
			The wireless device name used in the UCI wireless configuration ('radio0'
			on the supported TP-Link devices with a recent OpenWRT version).

#endmenu
```
